## sdkconfig.defaults
```kconfig
# Base: align with the LVGL QSPI+RAM demo, then enable networking + OTA + storage.
CONFIG_IDF_TARGET="esp32s3"

CONFIG_ESPTOOLPY_FLASHMODE_QIO=y
CONFIG_ESPTOOLPY_FLASHSIZE_16MB=y
CONFIG_PARTITION_TABLE_CUSTOM=y
CONFIG_PARTITION_TABLE_CUSTOM_FILENAME="partitions.csv"

CONFIG_COMPILER_OPTIMIZATION_PERF=y
CONFIG_ESP_DEFAULT_CPU_FREQ_MHZ_240=y
CONFIG_FREERTOS_HZ=1000

# PSRAM (required for LVGL buffers)
CONFIG_SPIRAM=y
CONFIG_SPIRAM_MODE_OCT=y
CONFIG_SPIRAM_FETCH_INSTRUCTIONS=y
CONFIG_SPIRAM_RODATA=y
CONFIG_SPIRAM_SPEED_80M=y

# LVGL (match existing demo defaults)
CONFIG_LV_DISP_DEF_REFR_PERIOD=4
CONFIG_LV_INDEV_DEF_READ_PERIOD=4
CONFIG_LV_COLOR_DEPTH_16=y
CONFIG_LV_COLOR_DEPTH=16
CONFIG_LV_COLOR_16_SWAP=y
CONFIG_LV_MEM_CUSTOM=y
CONFIG_LV_MEMCPY_MEMSET_STD=y
CONFIG_LV_IMG_CACHE_DEF_SIZE=2
CONFIG_LV_ATTRIBUTE_FAST_MEM_USE_IRAM=y
CONFIG_LV_FONT_MONTSERRAT_12=y
CONFIG_LV_FONT_MONTSERRAT_16=y

# Wi-Fi + SNTP time
CONFIG_ESP_WIFI_ENABLED=y
CONFIG_ESP_WIFI_SOFTAP_SUPPORT=n
CONFIG_LWIP_SNTP_MAX_SERVERS=2

# BT (NimBLE)
CONFIG_BT_ENABLED=y
CONFIG_BT_NIMBLE_ENABLED=y

# FATFS
CONFIG_FATFS_VFS_FSTAT_BLKSIZE=4096

# SDMMC example pin defaults (can be overridden in menuconfig)
CONFIG_EXAMPLE_SDMMC_BUS_WIDTH_1=y
CONFIG_EXAMPLE_PIN_CMD=1
CONFIG_EXAMPLE_PIN_CLK=2
CONFIG_EXAMPLE_PIN_D0=3

# Enable USB Serial JTAG for logging
CONFIG_ESP_CONSOLE_USB_SERIAL_JTAG=y
CONFIG_ESP_CONSOLE_SECONDARY_NONE=y

# Boot logging
CONFIG_BOOTLOADER_LOG_LEVEL_INFO=y
CONFIG_LOG_DEFAULT_LEVEL_INFO=y

# XPowers PMU (AXP2101) Configuration
CONFIG_PMU_I2C_SCL=14
CONFIG_PMU_I2C_SDA=15
CONFIG_PMU_INTERRUPT_PIN=-1

# LVGL PNG support for boot splash
CONFIG_LV_USE_PNG=y

# Media app
CONFIG_LV_USE_GIF=y
CONFIG_LV_USE_SJPG=y
```
